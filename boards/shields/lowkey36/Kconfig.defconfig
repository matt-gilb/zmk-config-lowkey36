## boards/shields/lowkey36/Kconfig.defconfig
```kconfig
if SHIELD_LOWKEY36_LEFT

config ZMK_KEYBOARD_NAME
    default "LowKey36"

config ZMK_SPLIT_ROLE_CENTRAL
    default y

endif

if SHIELD_LOWKEY36_LEFT || SHIELD_LOWKEY36_RIGHT

config ZMK_SPLIT
    default y

endif
```

## boards/shields/lowkey36/Kconfig.shield
```kconfig
# Copyright (c) 2024 Matt Gilbert
# SPDX-License-Identifier: MIT

config SHIELD_LOWKEY36_LEFT
    def_bool $(shields_list_contains,lowkey36_left)

config SHIELD_LOWKEY36_RIGHT
    def_bool $(shields_list_contains,lowkey36_right)
```
